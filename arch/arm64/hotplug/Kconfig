## arch/arm64/hotplug/Kconfig
```kconfig
config ALUCARD_HOTPLUG
	bool "Enable alucard-hotplug cpu hotplug driver"
	default n
	help
	Generic Alucard-hotplug cpu hotplug driver for ARM SOCs
           
config THUNDERPLUG_CONTROL
	bool "Enable plugging down/up of cores using powersuspend"
	default n
	help
	  This driver uses powersuspend to take down the cpu cores
	  on a octa core device.

config AiO_HotPlug
       bool "An All in One HotPlug for Octa-Core big.LITTLE SoCs."
       default n
       help
	    An All in One HotPlug for Quad, Hexa and Octa-Core SoCs as well as 
	    Traditional and big.LITTLE SoCs developed by Shoaib Anwar a.k.a Shoaib0597. 
	    This HotPlug is not a Load-Based HotPlug. Hence, this HotPlug is very 
	    Efficient in terms of CPU and Battery Consumption. Moreover, as the 
	    name indicates, this HotPlug provides absolute flexibility in terms 
	    of usage.
```
